#include "sdcard.h"
#include "hardware.h"
#include "stm32f4xx.h"

 

// Атомарное управление линией выбора чипа CS (Оставили на надежном PA4)
#define SD_CS_LOW()   GPIOA->BSRR = GPIO_BSRR_BR4                               // Опускаем PA4 в ноль - карта выбрана
#define SD_CS_HIGH()  GPIOA->BSRR = GPIO_BSRR_BS4                               // Поднимаем PA4 в единицу - карта активна

// Скоростной аппаратный обмен байтами через независимый модуль SPI3
uint8_t SPI3_Transfer(uint8_t byte) {
    SPI3->DR = byte;                                                            // Записываем байт в регистр данных SPI3 для отправки
    while (!(SPI3->SR & SPI_SR_RXNE));                                          // Ждем, пока аппаратный буфер приема полностью заполнится
    return SPI3->DR;                                                            // Читаем и возвращаем принятый от карты байт
}

static uint8_t SD_SendCommand(uint8_t cmd, uint32_t arg) {
    uint8_t response;                                                           // Переменная для хранения ответа карты
    uint16_t retry = 0;                                                         // Счетчик таймаута ожидания ответа

    if (cmd & 0x80) {                                                           // Если передана прикладная команда ACMD
        SD_SendCommand(CMD55, 0);                                               // Сначала отправляем обязательную префиксную CMD55
        cmd &= 0x7F;                                                            // Снимаем маркер прикладной команды
    }

    SD_CS_LOW();                                                                // Активируем карту памяти перед отправкой пакета
    
    SPI3_Transfer(0x40 | cmd);                                                  // Передаем индекс команды с установленным шестым битом
    SPI3_Transfer((arg >> 24) & 0xFF);                                          // Передаем старший байт аргумента команды
    SPI3_Transfer((arg >> 16) & 0xFF);                                          // Передаем второй байт аргумента команды
    SPI3_Transfer((arg >> 8) & 0xFF);                                           // Передаем третий байт аргумента команды
    SPI3_Transfer(arg & 0xFF);                                                  // Передаем младший байт аргумента команды
    
    uint8_t crc = 0xFF;                                                         // По умолчанию CRC не используется в SPI режиме
    if (cmd == CMD0) crc = 0x95;                                                // Валидный CRC код, обязательный строго для CMD0
    if (cmd == CMD8) crc = 0x87;                                                // Валидный CRC код, обязательный строго для CMD8
    SPI3_Transfer(crc);                                                         // Отправляем байт контрольной суммы в шину

    do {
        response = SPI3_Transfer(0xFF);                                         // Вычитываем шину в ожидании ответа (не 0xFF)
    } while ((response & 0x80) && ++retry < 1000);                              // Крутимся, пока у ответа поднят старший бит занятости

    return response;                                                            // Возвращаем чистый R1 статус ответа карты
}

uint8_t SD_Init(void) {
    uint8_t response;                                                           // Переменная для анализа ответов инициализации
    uint16_t retry = 0;                                                         // Локальный счетчик таймаута для циклов
    uint16_t acmd_retry = 0;                                                    // Отдельный счетчик для инициализации структуры памяти

    SPI3->CR1 &= ~SPI_CR1_SPE;                                                  // Временно отключаем SPI3 для изменения делителя частоты
    SPI3->CR1 &= ~SPI_CR1_BR;                                                   // Очищаем биты делителя частоты (Baud Rate)
    SPI3->CR1 |= (6 << SPI_CR1_BR_Pos);                                         // Выставляем DIV128 для инициализации карты (~328 кГц)
    SPI3->CR1 |= SPI_CR1_SPE;                                                   // Снова активируем модуль SPI3

    SD_CS_HIGH();                                                               // Деактивируем линию CS перед стартовой посылкой
    delay_ms(40);                                                               // Даем карте время на внутренний запуск питания

    for (uint8_t i = 0; i < 20; i++) {
        SPI3_Transfer(0xFF);                                                    // Проталкиваем 160 пустых тактов для синхронизации логики
    }

    do {
        response = SD_SendCommand(CMD0, 0);                                     // Отправляем команду программного сброса карты GO_IDLE
    } while (response != R1_IDLE_STATE && ++retry < 1000);                      // Ждем перехода карты в отладочный idle режим

    if (response != R1_IDLE_STATE) { SD_CS_HIGH(); return 1; }                  // Если карта не ответила, выходим с кодом ошибки 1

    response = SD_SendCommand(CMD8, 0x1AA);                                     // Проверяем версию спецификации карты
    if (response == R1_IDLE_STATE) {                                            // Если карта распознала команду интерфейса
        for (uint8_t i = 0; i < 4; i++) SPI3_Transfer(0xFF);                    // Вычитываем 32 бита возвращаемого эхо-аргумента
    } else if (!(response & R1_ILLEGAL_COMMAND)) { SD_CS_HIGH(); return 2; }    // Если сбой критический, выходим с ошибкой 2

    do {
        response = SD_SendCommand(ACMD41 | 0x80, 0x40000000);                   // Активируем внутренний процесс инициализации карты
    } while (response != R1_READY_STATE && ++acmd_retry < 4000);                // Ждем пока карта сбросит бит инициализации в ноль

    if (response != R1_READY_STATE) { SD_CS_HIGH(); return 3; }                 // Если карта таймаутнула, выходим с ошибкой 3

    // Карта успешно инициализирована, теперь разгоняем SPI3 на полную рабочую скорость!
    SPI3->CR1 &= ~SPI_CR1_SPE;                                                  // Отключаем SPI3 для изменения скорости
    SPI3->CR1 &= ~SPI_CR1_BR;                                                   // Очищаем биты делителя
    SPI3->CR1 |= (1 << SPI_CR1_BR_Pos);                                         // Выставляем DIV4: 42 МГц / 4 = Полновесные 10.5 МГц!
    SPI3->CR1 |= SPI_CR1_SPE;                                                   // Включаем SPI3 обратно

    SD_CS_HIGH();                                                               // Переводим карту в пассивное состояние на шине
    SPI3_Transfer(0xFF);                                                        // Проталкиваем финальный завершающий байт синхронизации
    return 0;                                                                   // Успешное завершение аппаратной инициализации
}

uint8_t SD_ReadSector(uint32_t sector, uint8_t *buffer) {
    uint32_t timeout = 60000;                                                   // Задаем лимит ожидания готовности блока данных

 

    if (SD_SendCommand(CMD17, sector) != 0x00) {                                // Отправляем команду чтения одиночного сектора 512 байт
        SD_CS_HIGH();                                                           // Сбрасываем выбор чипа в случае отказа
        return 1;                                                               // Выходим из функции с кодом ошибки команды 1
    }

    while (SPI3_Transfer(0xFF) != 0xFE) {                                       // Вычитываем шину в ожидании аппаратного маркера данных 0xFE
        if (--timeout == 0) {                                                   // Если карта не прислала маркер вовремя
            SD_CS_HIGH();                                                       // Освобождаем шину данных
            return 2;                                                           // Выходим по аппаратному таймауту с ошибкой 2
        }
    }

    uint8_t *ptr = buffer;                                                      // Направляем рабочий указатель на целевой буфер памяти
    for (uint16_t i = 0; i < 512; i++) {
        *ptr++ = SPI3_Transfer(0xFF);                                           // Высокоскоростное чтение байт сектора через SPI3
    }

    SPI3_Transfer(0xFF);                                                        // Читаем и отбрасываем первый байт контрольной суммы CRC
    SPI3_Transfer(0xFF);                                                        // Читаем и отбрасываем второй байт контрольной суммы CRC

    SD_CS_HIGH();                                                               // Закрываем сессию чтения, поднимая линию CS
    SPI3_Transfer(0xFF);                                                        // Даем шине один пустой такт для завершения работы карты
    return 0;                                                                   // Сектор успешно считан на скорости 10.5 МГц!
}

uint8_t SD_CheckPresence(void) { 
    return 0;                                                                   // Заглушка проверки физического присутствия карты
}